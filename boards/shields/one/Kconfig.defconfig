## boards/shields/tortie/Kconfig.defconfig
```kconfig
if SHIELD_TORTIE_LEFT

config ZMK_KEYBOARD_NAME
    default "tortie"

config ZMK_SPLIT_ROLE_CENTRAL
    default y

endif # SHIELD_TORTIE_LEFT

if SHIELD_TORTIE_LEFT || SHIELD_TORTIE_RIGHT

config ZMK_SPLIT
    default y

endif # SHIELD_TORTIE_LEFT || SHIELD_TORTIE_RIGHT
```

## boards/shields/tortie/Kconfig.shield
```kconfig
config SHIELD_TORTIE_LEFT
    def_bool $(shields_list_contains,tortie_left)

config SHIELD_TORTIE_RIGHT
    def_bool $(shields_list_contains,tortie_right)
```
